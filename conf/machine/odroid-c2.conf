## conf/machine/odroid-c2.conf
```bitbake
#@TYPE: Machine
#@NAME: odroid-c2
#@DESCRIPTION: Machine configuration for odroid-c2 systems

SOC_FAMILY = "amlogic:Meson"
require conf/machine/include/soc-family.inc

DEFAULTTUNE = "aarch64"
require conf/machine/include/arm/arch-armv8a.inc

PREFERRED_PROVIDER_virtual/kernel = "linux-stable"
KERNEL_IMAGETYPE = "Image"

PREFERRED_PROVIDER_virtual/bootloader = "u-boot"
PREFERRED_PROVIDER_u-boot = "u-boot"
UBOOT_MACHINE = "odroid-c2_defconfig"
BOOTENV_SIZE = "0x20000"

EXTRA_IMAGEDEPENDS += "u-boot secure-odroid-c2"

SERIAL_CONSOLES = "115200;ttyAML0"

IMAGE_FSTYPES = "tar.xz"

MACHINE_ESSENTIAL_EXTRA_RDEPENDS = "kernel-image kernel-devicetree"

MACHINE_FEATURES = "ext2 serial usbhost vfat mali"

VIRTUAL-RUNTIME_mesa = "mesa-gl"
PREFERRED_PROVIDER_virtual/gpu ?= "${@bb.utils.contains("MACHINE_FEATURES", "mali", "mali-450", "mesa-gl", d)}"

PREFERRED_PROVIDER_virtual/egl = "${PREFERRED_PROVIDER_virtual/gpu}"
PREFERRED_PROVIDER_virtual/libgbm = "${PREFERRED_PROVIDER_virtual/gpu}"
PREFERRED_PROVIDER_virtual/libgles1 = "${PREFERRED_PROVIDER_virtual/gpu}"
PREFERRED_PROVIDER_virtual/libgles2 = "${PREFERRED_PROVIDER_virtual/gpu}"
PREFERRED_PROVIDER_virtual/libopencl = "${PREFERRED_PROVIDER_virtual/gpu}"
PREFERRED_PROVIDER_virtual/libgl = "${VIRTUAL-RUNTIME_mesa}"
PREFERRED_PROVIDER_virtual/mesa = "${VIRTUAL-RUNTIME_mesa}"
```
